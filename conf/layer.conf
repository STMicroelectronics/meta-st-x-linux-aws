## conf/layer.conf
```bitbake
# We have a conf and classes directory, add to BBPATH
BBPATH .= ":${LAYERDIR}"

# We have recipes-* directories, add to BBFILES
BBFILES += "${LAYERDIR}/recipes-*/*/*.bb \
            ${LAYERDIR}/recipes-*/*/*.bbappend"

BBFILE_COLLECTIONS += "meta-st-x-linux-aws"
BBFILE_PATTERN_meta-st-x-linux-aws = "^${LAYERDIR}/"
BBFILE_PRIORITY_meta-st-x-linux-aws = "6"

LAYERDEPENDS_meta-st-x-linux-aws = "core"
LAYERSERIES_COMPAT_meta-st-x-linux-aws = "scarthgap"

# OpenSTLinux compatibility version
ST_OSTL_COMPATIBILITY_VERSION_meta-st-x-linux-aws = "6.0"

DISTRO_FEATURES:append = " security"
DISTRO_FEATURES:append = " tpm2"
```
